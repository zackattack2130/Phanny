## boards/shields/phanny/Kconfig.defconfig
```kconfig
if SHIELD_PHANNY_LEFT

# Name must be less than 16 characters long!
config ZMK_KEYBOARD_NAME
    default "Phanny"

config ZMK_SPLIT_ROLE_CENTRAL
    default y

endif

if SHIELD_PHANNY_LEFT || SHIELD_PHANNY_RIGHT

config ZMK_SPLIT
    default y

endif
```

## boards/shields/phanny/Kconfig.shield
```kconfig
config SHIELD_PHANNY_LEFT
    def_bool $(shields_list_contains,phanny_left)

config SHIELD_PHANNY_RIGHT
    def_bool $(shields_list_contains,phanny_right)
```
